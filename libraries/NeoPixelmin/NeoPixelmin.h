/*
 * NeoPixelmin.h — Lightweight WS2812B (NeoPixel) driver for CH32V003
 *
 * Header-only. No dynamic allocation. No Adafruit_NeoPixel dependency.
 * The bit waveform is generated by SPI1, not by cycle-counted GPIO toggling,
 * so show() does NOT have to disable interrupts — important on this board
 * because USB is a software stack (rv003usb) with hard timing requirements.
 *
 * ── Output pin is FIXED ─────────────────────────────────────────────────────
 *   DIN must be wired to  pin 8 / PC6 (SPI1 MOSI) = NEOPIXELMIN_PIN.
 *   The `pin` argument of the constructor is accepted for source compatibility
 *   with Adafruit_NeoPixel but is ignored; ok() returns false if it is wrong.
 *   SCK (PC5), MISO (PC7) and NSS (PC1) are left untouched — SPI1 runs in
 *   1-line transmit-only mode, so only PC6 is consumed.
 *   Do NOT use together with SPI.h / SDmin (both drive SPI1).
 *
 * ── How the waveform is made ────────────────────────────────────────────────
 *   SPI clock 6 MHz → 166.7 ns per SPI bit. One WS2812 bit = one SPI byte:
 *       "0" = 0b11000000  → T0H 333 ns / T0L 1000 ns
 *       "1" = 0b11111000  → T1H 833 ns / T1L  500 ns
 *   Bit period 1.33 us (spec 1.25 us +/-600 ns). All four times are inside the
 *   WS2812B datasheet window. Bytes are pushed two at a time as 16-bit SPI
 *   frames, i.e. one register write every 2.67 us (128 CPU cycles at 48 MHz),
 *   which leaves plenty of slack for an interrupt to run in between.
 *   A short stall only stretches the low part of a bit; it corrupts the frame
 *   only if it exceeds the reset time.
 *   SPI1 leaves MOSI HIGH whenever it is idle, which would turn the gap
 *   between frames into a long high instead of a reset. PC6 is therefore held
 *   as a plain GPIO output low, and handed to the SPI only while data is on
 *   the wire -- see show(). Without this only the first LED misbehaves, since
 *   every LED behind it is fed by the reshaped output of the first one.
 *
 * ── API (Adafruit_NeoPixel compatible subset) ───────────────────────────────
 *   NeoPixelmin pixels(count, pin, NEO_GRB + NEO_KHZ800);
 *   begin()                       — init SPI1 / PC6
 *   show()                        — send the buffer to the strip
 *   clear()                       — set every pixel to 0 (does not show)
 *   setPixelColor(i, color)       — color from Color()
 *   setPixelColor(i, r, g, b)
 *   getPixelColor(i)              — 0x00RRGGBB, before brightness scaling
 *   fill(color, first, count)     — count 0 = to the end
 *   setBrightness(b) / getBrightness()
 *   Color(r, g, b)                — pack into 0x00RRGGBB (static)
 *   numPixels()                   — pixels actually allocated
 *   getPixels()                   — raw buffer, numPixels()*3 bytes
 *   ok()                          — false if count > MAX or pin was wrong
 *
 *   Not provided (deliberately, to stay small): RGBW/SK6812, NEO_KHZ400,
 *   gamma32()/ColorHSV(), updateLength(), setPin().
 *
 * ── Configuration (define before #include) ──────────────────────────────────
 *   NEOPIXELMIN_MAX_LEDS   REQUIRED. Pixel buffer size, 3 bytes each.
 *                          Not defining it is a compile error on purpose.
 *   NEOPIXELMIN_RESET_US   idle-low time before a frame      (default 300)
 *                          50 us is enough for WS2812B, 280 us for the V5 die
 *   NEOPIXELMIN_T0H_BITS   high part of a "0", in SPI bits   (default 2 = 333 ns)
 *   NEOPIXELMIN_T1H_BITS   high part of a "1", in SPI bits   (default 5 = 833 ns)
 *                          try 6 (1000 ns) if only the first LED reads wrong
 *   NEOPIXELMIN_ATOMIC     define to disable interrupts during show()
 *                          (fallback if software USB corrupts the frame)
 */
#pragma once
#include <Arduino.h>

#if !defined(CH32V003)
  #error "NeoPixelmin supports CH32V003 only."
#endif

// ── Configuration ─────────────────────────────────────────────────────────────
/* Plain integer literal — this is evaluated by #if, so no casts allowed here. */
#ifndef NEOPIXELMIN_FCPU_HZ
  #ifdef F_CPU
    #define NEOPIXELMIN_FCPU_HZ F_CPU
  #else
    #define NEOPIXELMIN_FCPU_HZ 48000000UL
  #endif
#endif

/* Mandatory: there is no sane default. Too small silently truncates the strip,
   too large silently wastes RAM, and neither shows up until you are on the
   bench. Make the sketch state the number it actually drives. */
#ifndef NEOPIXELMIN_MAX_LEDS
  #error "NEOPIXELMIN_MAX_LEDS を #include <NeoPixelmin.h> の前に定義してください（例: #define NEOPIXELMIN_MAX_LEDS 256）"
#endif

#ifndef NEOPIXELMIN_RESET_US
  #define NEOPIXELMIN_RESET_US 300u
#endif

/* The reset gap is timed with SysTick, not micros().
   micros() drags in the same uint64_t division as millis() and costs 2224
   bytes of Flash on CH32V003 (measured) -- more than twice the size of this
   whole driver, spent on one idle wait. SysTick->CNT is the free-running
   counter micros() itself reads, so counting raw ticks measures exactly the
   same thing without the division.
   The 32-bit count wraps after ~89 s at 48 MHz. A wrap can only make show()
   wait one extra reset gap (300 us); it can never cut the gap short, because
   reaching the wrap means far more than 300 us has passed already. */
#define _NP_RESET_TICKS ((uint32_t)(NEOPIXELMIN_RESET_US) * \
                         (uint32_t)(NEOPIXELMIN_FCPU_HZ / 1000000UL))

/* Symbol shape, in SPI bits (166.7 ns each) out of the 8 bits per WS2812 bit.
   Defaults: T0H = 2 bits = 333 ns, T1H = 5 bits = 833 ns.
   Raise T1H to 6 (1000 ns) if the FIRST LED of the strip reads ones as zeros —
   only the first LED sees the raw waveform, every other one sees the signal
   after that LED has reshaped it, which is why the symptom stops at pixel 0. */
#ifndef NEOPIXELMIN_T0H_BITS
  #define NEOPIXELMIN_T0H_BITS 2u
#endif
#ifndef NEOPIXELMIN_T1H_BITS
  #define NEOPIXELMIN_T1H_BITS 5u
#endif
#if (NEOPIXELMIN_T0H_BITS) < 1u || (NEOPIXELMIN_T0H_BITS) >= (NEOPIXELMIN_T1H_BITS)
  #error "NEOPIXELMIN_T0H_BITS は 1 以上かつ NEOPIXELMIN_T1H_BITS 未満にしてください"
#endif
#if (NEOPIXELMIN_T1H_BITS) > 6u
  #error "NEOPIXELMIN_T1H_BITS は 6 以下にしてください（Low 期間が短くなりすぎます）"
#endif

// DIN pin is dictated by SPI1 MOSI.
#define NEOPIXELMIN_PIN PIN_SPI_MOSI

// ── SPI baud rate: PCLK2 (= F_CPU) must divide down to 6 MHz ──────────────────
#if   (NEOPIXELMIN_FCPU_HZ / 6000000UL) == 8   /* 48 MHz */
  #define _NP_BR 2u
#elif (NEOPIXELMIN_FCPU_HZ / 6000000UL) == 4   /* 24 MHz */
  #define _NP_BR 1u
#elif (NEOPIXELMIN_FCPU_HZ / 6000000UL) == 2   /* 12 MHz */
  #define _NP_BR 0u
#else
  #error "NeoPixelmin needs F_CPU = 48, 24 or 12 MHz (SPI must reach 6 MHz)."
#endif

// ── Color order constants (same encoding as Adafruit_NeoPixel) ────────────────
#define NEO_RGB ((0u<<6)|(0u<<4)|(1u<<2)|(2u))
#define NEO_RBG ((0u<<6)|(0u<<4)|(2u<<2)|(1u))
#define NEO_GRB ((1u<<6)|(1u<<4)|(0u<<2)|(2u))
#define NEO_GBR ((2u<<6)|(2u<<4)|(0u<<2)|(1u))
#define NEO_BRG ((1u<<6)|(2u<<4)|(2u<<2)|(0u))
#define NEO_BGR ((2u<<6)|(2u<<4)|(1u<<2)|(0u))
#define NEO_KHZ800 0x0000u

typedef uint16_t neoPixelType;

// One WS2812 bit = one SPI byte, MSB first: N high bits then low for the rest.
#define _NP_SYM(hb) ((uint8_t)(0xFFu << (8u - (hb))))
#define _NP_S0      _NP_SYM(NEOPIXELMIN_T0H_BITS)
#define _NP_S1      _NP_SYM(NEOPIXELMIN_T1H_BITS)

// Two WS2812 bits per 16-bit SPI frame, indexed by those two bits.
static const uint16_t _np_enc2[4] = {
  (uint16_t)(((uint16_t)_NP_S0 << 8) | _NP_S0),
  (uint16_t)(((uint16_t)_NP_S0 << 8) | _NP_S1),
  (uint16_t)(((uint16_t)_NP_S1 << 8) | _NP_S0),
  (uint16_t)(((uint16_t)_NP_S1 << 8) | _NP_S1),
};

class NeoPixelmin {
public:
  NeoPixelmin(uint16_t n, uint8_t pin = NEOPIXELMIN_PIN,
              neoPixelType type = NEO_GRB + NEO_KHZ800) {
    _ok = (n <= NEOPIXELMIN_MAX_LEDS) && (pin == NEOPIXELMIN_PIN);
    _n  = (n > NEOPIXELMIN_MAX_LEDS) ? (uint16_t)NEOPIXELMIN_MAX_LEDS : n;
    _rO = (uint8_t)((type >> 4) & 3u);
    _gO = (uint8_t)((type >> 2) & 3u);
    _bO = (uint8_t)( type       & 3u);
    _bri = 0;                 // 0 = no scaling, like Adafruit_NeoPixel
    clear();
  }

  void begin(void) {
    RCC->APB2PCENR |= (1u<<4) | (1u<<12);   // GPIOC clock, SPI1 clock

    // Park PC6 as a plain GPIO driving low. SPI1 leaves MOSI HIGH when it is
    // idle, and a high line between frames is not a reset -- the first LED
    // swallows that idle level into its first bit and shows garbage while
    // every LED behind it, fed by the reshaped output of the first one, looks
    // perfect. The pin is handed to the SPI only while data is on the wire.
    _pin_gpio_low();

    SPI1->CTLR1 = 0;
    SPI1->CTLR1 = SPI_CTLR1_MSTR                    // master
                | (uint16_t)(_NP_BR << 3)           // baud -> 6 MHz
                | SPI_CTLR1_SSM | SPI_CTLR1_SSI     // software NSS, no MODF
                | SPI_CTLR1_DFF                     // 16-bit frames
                | SPI_CTLR1_BIDIMODE | SPI_CTLR1_BIDIOE  // 1-line, transmit
                | SPI_CTLR1_SPE;                    // enable
    // CPOL=0, CPHA=0, MSB first.
    _last = SysTick->CNT;
  }

  void show(void) {
    // Hold the line low long enough for the previous frame to latch and for
    // the strip to resynchronise. Costs nothing if the sketch is already slow.
    while ((uint32_t)(SysTick->CNT - _last) < _NP_RESET_TICKS) { }

    const uint8_t *p = _buf;
    uint16_t       n = (uint16_t)(_n * 3u);

#ifdef NEOPIXELMIN_ATOMIC
    noInterrupts();
#endif
    // Get zeros moving through the shift register first, then hand the pin to
    // the SPI. Waiting for TXE means the second word has reached the shifter,
    // so the line is being actively driven low at the moment of the handover
    // and no idle-high glitch reaches the strip.
    _put(0x0000u);
    _put(0x0000u);
    while (!(SPI1->STATR & SPI_STATR_TXE)) { }
    _pin_af();

    while (n--) {
      uint8_t v = _scale(*p++);
      _put(_np_enc2[(v >> 6) & 3u]);
      _put(_np_enc2[(v >> 4) & 3u]);
      _put(_np_enc2[(v >> 2) & 3u]);
      _put(_np_enc2[ v       & 3u]);
    }

    // Same trick in reverse: queue a word of zeros, wait until it has reached
    // the shift register (which means the last real word is fully out), and
    // take the pin back while the line is low.
    _put(0x0000u);
    while (!(SPI1->STATR & SPI_STATR_TXE)) { }
    _pin_gpio_low();
    while (SPI1->STATR & SPI_STATR_BSY) { }
#ifdef NEOPIXELMIN_ATOMIC
    interrupts();
#endif
    _last = SysTick->CNT;
  }

  void clear(void) {
    for (uint16_t i = 0; i < (uint16_t)(_n * 3u); i++) _buf[i] = 0;
  }

  void setPixelColor(uint16_t i, uint8_t r, uint8_t g, uint8_t b) {
    if (i >= _n) return;
    uint8_t *p = &_buf[i * 3u];
    p[_rO] = r;
    p[_gO] = g;
    p[_bO] = b;
  }

  void setPixelColor(uint16_t i, uint32_t c) {
    setPixelColor(i, (uint8_t)(c >> 16), (uint8_t)(c >> 8), (uint8_t)c);
  }

  uint32_t getPixelColor(uint16_t i) const {
    if (i >= _n) return 0;
    const uint8_t *p = &_buf[i * 3u];
    return ((uint32_t)p[_rO] << 16) | ((uint32_t)p[_gO] << 8) | (uint32_t)p[_bO];
  }

  void fill(uint32_t c = 0, uint16_t first = 0, uint16_t count = 0) {
    uint16_t last = count ? (uint16_t)(first + count) : _n;
    if (last > _n) last = _n;
    for (uint16_t i = first; i < last; i++) setPixelColor(i, c);
  }

  // b = 0..255. 0 turns the strip off, 255 is full scale (Adafruit semantics:
  // the stored value is b+1 and scaling is (v * (b+1)) >> 8, non-destructive).
  void setBrightness(uint8_t b) { _bri = (uint16_t)b + 1u; }
  uint8_t getBrightness(void) const { return _bri ? (uint8_t)(_bri - 1u) : 255; }

  uint16_t numPixels(void) const { return _n; }

  // Raw pixel buffer, numPixels() * 3 bytes. Lets a sketch rotate or dim the
  // strip as plain bytes instead of taking every pixel apart with
  // getPixelColor() and putting it back together with setPixelColor() -- the
  // round trip through 32-bit colors costs a few hundred bytes of Flash on
  // this part, which matters when the sketch is already near the 16 KB limit.
  // Three things differ from getPixelColor():
  //   - the bytes are in strip order (G, R, B for NEO_GRB), not R, G, B
  //   - the values are unscaled; setBrightness() is applied in show()
  //   - there is no bounds check, so staying inside numPixels() * 3 is the
  //     caller's job
  // Reordering the color bytes is symmetric, so byte-level work on the buffer
  // gives the same result as going through getPixelColor()/setPixelColor().
  // const, returning a non-const pointer, matches Adafruit_NeoPixel.
  uint8_t *getPixels(void) const { return (uint8_t *)_buf; }

  bool     ok(void) const { return _ok; }

  static uint32_t Color(uint8_t r, uint8_t g, uint8_t b) {
    return ((uint32_t)r << 16) | ((uint32_t)g << 8) | (uint32_t)b;
  }

private:
  inline uint8_t _scale(uint8_t v) const {
    return _bri ? (uint8_t)(((uint16_t)v * _bri) >> 8) : v;
  }

  static inline void _put(uint16_t w) {
    while (!(SPI1->STATR & SPI_STATR_TXE)) { }
    SPI1->DATAR = w;
  }

  // PC6 = CFGLR bits [27:24]. 0x3 = GPIO push-pull 50 MHz, 0xB = AF push-pull.
  static inline void _pin_gpio_low(void) {
    GPIOC->BCR   = (1u << 6);   // drive low first, then take the pin back
    GPIOC->CFGLR = (GPIOC->CFGLR & ~(0xFu<<24)) | (0x3u<<24);
  }

  static inline void _pin_af(void) {
    GPIOC->CFGLR = (GPIOC->CFGLR & ~(0xFu<<24)) | (0xBu<<24);
  }

  uint8_t  _buf[NEOPIXELMIN_MAX_LEDS * 3];
  uint32_t _last;
  uint16_t _n;
  uint16_t _bri;
  uint8_t  _rO, _gO, _bO;
  bool     _ok;
};
